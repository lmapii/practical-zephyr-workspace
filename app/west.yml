## app/west.yml
```yaml
manifest:
  # minimum west version
  version: 0.8

  # `self` defines whatever is only relevant for this manifest file
  # e.g., if we'd like to move the entire repository into a subfolder, we could do this:
  self:
    path: src

  projects:
    # the project name is used as directory name, but considers the given `path-prefix`
    - name: zephyr
      # instead of a tag, `revision` also supports hashes and branches. e.g., `--freeze` will
      # replace all revisions with their aactual commit hashes since tags can always be modified.
      revision: v3.4.0
      url: https://github.com/zephyrproject-rtos/zephyr
      west-commands: scripts/west-commands.yml
      import:
        path-prefix: deps
        file: west.yml
        name-allowlist:
          - nrf
          - zephyr
          - cmsis
          - hal_nordic
          - hal_stm32
```
